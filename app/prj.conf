## CMakeLists.txt
```
#-------------------------------------------------------------------------------
# Zephyr Example Application
#
# Copyright (c) 2021 Nordic Semiconductor ASA
# SPDX-License-Identifier: Apache-2.0

cmake_minimum_required(VERSION 3.13.1)

# Allow standalone builds when this repo is not listed in the workspace manifest.
get_filename_component(APP_MODULE_ROOT "${CMAKE_CURRENT_SOURCE_DIR}/.." ABSOLUTE)
list(APPEND ZEPHYR_EXTRA_MODULES "${APP_MODULE_ROOT}")

find_package(Zephyr REQUIRED HINTS $ENV{ZEPHYR_BASE})

project(app LANGUAGES C)

set(LVGL_DIR ${ZEPHYR_LVGL_MODULE_DIR})

target_sources(app PRIVATE 
  src/main.c
  src/shared/shared.c
  src/threads/blink_threads.c
  src/threads/gpio_thread.c
  src/threads/rtc_thread.c
)

target_sources_ifdef(CONFIG_BT app PRIVATE
  src/threads/ble_hr_thread.c
)

target_sources_ifdef(CONFIG_MSPI app PRIVATE
  src/threads/mspi_stress_thread.c
  src/whoop_spi/spi_bus_mspi_driver.c
  src/whoop_spi/spi_bus.c
  src/whoop_spi/nand_cmd.c
)

if(CONFIG_MSPI)
  target_include_directories(app PRIVATE
    ${ZEPHYR_BASE}/drivers/mspi
    ${CMAKE_CURRENT_SOURCE_DIR}/src/whoop_spi
  )
endif()

target_sources_ifdef(CONFIG_LVGL app PRIVATE
  src/threads/lvgl_demo.c
)

target_sources_ifdef(CONFIG_AUDIO_DMIC app PRIVATE
  src/threads/audio_thread.c
)

if(CONFIG_LVGL)
target_include_directories(app PRIVATE
  ${LVGL_DIR}/demos/
)
endif()

target_sources_ifdef(CONFIG_LV_USE_DEMO_MUSIC app PRIVATE
    ${LVGL_DIR}/demos/music/lv_demo_music_list.c
    ${LVGL_DIR}/demos/music/lv_demo_music.c
    ${LVGL_DIR}/demos/music/lv_demo_music_main.c
    ${LVGL_DIR}/demos/music/assets/img_lv_demo_music_btn_next.c
    ${LVGL_DIR}/demos/music/assets/img_lv_demo_music_wave_top_large.c
    ${LVGL_DIR}/demos/music/assets/img_lv_demo_music_icon_4_large.c
    ${LVGL_DIR}/demos/music/assets/img_lv_demo_music_icon_4.c
    ${LVGL_DIR}/demos/music/assets/img_lv_demo_music_corner_right.c
    ${LVGL_DIR}/demos/music/assets/img_lv_demo_music_cover_1.c
    ${LVGL_DIR}/demos/music/assets/img_lv_demo_music_slider_knob_large.c
    ${LVGL_DIR}/demos/music/assets/img_lv_demo_music_icon_3.c
    ${LVGL_DIR}/demos/music/assets/img_lv_demo_music_btn_pause.c
    ${LVGL_DIR}/demos/music/assets/img_lv_demo_music_btn_pause_large.c
    ${LVGL_DIR}/demos/music/assets/img_lv_demo_music_wave_bottom_large.c
    ${LVGL_DIR}/demos/music/assets/img_lv_demo_music_icon_2_large.c
    ${LVGL_DIR}/demos/music/assets/img_lv_demo_music_btn_list_play_large.c
    ${LVGL_DIR}/demos/music/assets/img_lv_demo_music_wave_top.c
    ${LVGL_DIR}/demos/music/assets/img_lv_demo_music_btn_play_large.c
    ${LVGL_DIR}/demos/music/assets/img_lv_demo_music_cover_1_large.c
    ${LVGL_DIR}/demos/music/assets/img_lv_demo_music_wave_bottom.c
    ${LVGL_DIR}/demos/music/assets/img_lv_demo_music_corner_left_large.c
    ${LVGL_DIR}/demos/music/assets/img_lv_demo_music_btn_play.c
    ${LVGL_DIR}/demos/music/assets/img_lv_demo_music_list_border.c
    ${LVGL_DIR}/demos/music/assets/img_lv_demo_music_icon_2.c
    ${LVGL_DIR}/demos/music/assets/img_lv_demo_music_btn_next_large.c
    ${LVGL_DIR}/demos/music/assets/img_lv_demo_music_btn_list_play.c
    ${LVGL_DIR}/demos/music/assets/img_lv_demo_music_list_border_large.c
    ${LVGL_DIR}/demos/music/assets/img_lv_demo_music_btn_rnd.c
    ${LVGL_DIR}/demos/music/assets/img_lv_demo_music_cover_3.c
    ${LVGL_DIR}/demos/music/assets/img_lv_demo_music_btn_prev_large.c
    ${LVGL_DIR}/demos/music/assets/img_lv_demo_music_btn_loop.c
    ${LVGL_DIR}/demos/music/assets/img_lv_demo_music_icon_1.c
    ${LVGL_DIR}/demos/music/assets/img_lv_demo_music_slider_knob.c
    ${LVGL_DIR}/demos/music/assets/img_lv_demo_music_corner_right_large.c
    ${LVGL_DIR}/demos/music/assets/img_lv_demo_music_btn_corner_large.c
    ${LVGL_DIR}/demos/music/assets/img_lv_demo_music_corner_left.c
    ${LVGL_DIR}/demos/music/assets/img_lv_demo_music_cover_2_large.c
    ${LVGL_DIR}/demos/music/assets/img_lv_demo_music_icon_3_large.c
    ${LVGL_DIR}/demos/music/assets/img_lv_demo_music_icon_1_large.c
    ${LVGL_DIR}/demos/music/assets/img_lv_demo_music_cover_2.c
    ${LVGL_DIR}/demos/music/assets/img_lv_demo_music_btn_prev.c
    ${LVGL_DIR}/demos/music/assets/img_lv_demo_music_btn_rnd_large.c
    ${LVGL_DIR}/demos/music/assets/img_lv_demo_music_btn_list_pause_large.c
    ${LVGL_DIR}/demos/music/assets/img_lv_demo_music_cover_3_large.c
    ${LVGL_DIR}/demos/music/assets/img_lv_demo_music_btn_list_pause.c
    ${LVGL_DIR}/demos/music/assets/img_lv_demo_music_logo.c
    ${LVGL_DIR}/demos/music/assets/img_lv_demo_music_btn_loop_large.c
)

target_sources_ifdef(CONFIG_LV_USE_DEMO_BENCHMARK app PRIVATE
    ${LVGL_DIR}/demos/benchmark/assets/img_benchmark_avatar.c
    ${LVGL_DIR}/demos/benchmark/assets/img_benchmark_lvgl_logo_argb.c
    ${LVGL_DIR}/demos/benchmark/assets/img_benchmark_lvgl_logo_rgb.c
    ${LVGL_DIR}/demos/benchmark/assets/lv_font_benchmark_montserrat_12_aligned.c
    ${LVGL_DIR}/demos/benchmark/assets/lv_font_benchmark_montserrat_14_aligned.c
    ${LVGL_DIR}/demos/benchmark/assets/lv_font_benchmark_montserrat_16_aligned.c
    ${LVGL_DIR}/demos/benchmark/assets/lv_font_benchmark_montserrat_18_aligned.c
    ${LVGL_DIR}/demos/benchmark/assets/lv_font_benchmark_montserrat_20_aligned.c
    ${LVGL_DIR}/demos/benchmark/assets/lv_font_benchmark_montserrat_24_aligned.c
    ${LVGL_DIR}/demos/benchmark/assets/lv_font_benchmark_montserrat_26_aligned.c
    ${LVGL_DIR}/demos/benchmark/lv_demo_benchmark.c
)

target_sources_ifdef(CONFIG_LV_USE_DEMO_STRESS app PRIVATE
    ${LVGL_DIR}/demos/stress/lv_demo_stress.c
)

target_sources_ifdef(CONFIG_LV_USE_DEMO_WIDGETS app PRIVATE
    ${LVGL_DIR}/demos/widgets/assets/img_clothes.c
    ${LVGL_DIR}/demos/widgets/assets/img_demo_widgets_avatar.c
    ${LVGL_DIR}/demos/widgets/assets/img_demo_widgets_needle.c
    ${LVGL_DIR}/demos/widgets/assets/img_lvgl_logo.c
    ${LVGL_DIR}/demos/widgets/lv_demo_widgets.c
)

target_sources_ifdef(CONFIG_LV_USE_DEMO_KEYPAD_AND_ENCODER app PRIVATE
    ${LVGL_DIR}/demos/keypad_encoder/lv_demo_keypad_encoder.c
)

target_sources_ifdef(CONFIG_LV_USE_DEMO_RENDER app PRIVATE
    ${LVGL_DIR}/demos/render/assets/img_render_arc_bg.c
    ${LVGL_DIR}/demos/render/assets/img_render_lvgl_logo_argb8888.c
    ${LVGL_DIR}/demos/render/assets/img_render_lvgl_logo_argb8888_premultiplied.c
    ${LVGL_DIR}/demos/render/assets/img_render_lvgl_logo_i1.c
    ${LVGL_DIR}/demos/render/assets/img_render_lvgl_logo_l8.c
    ${LVGL_DIR}/demos/render/assets/img_render_lvgl_logo_rgb565a8.c
    ${LVGL_DIR}/demos/render/assets/img_render_lvgl_logo_rgb565.c
    ${LVGL_DIR}/demos/render/assets/img_render_lvgl_logo_rgb565_swapped.c
    ${LVGL_DIR}/demos/render/assets/img_render_lvgl_logo_rgb888.c
    ${LVGL_DIR}/demos/render/assets/img_render_lvgl_logo_xrgb8888.c
    ${LVGL_DIR}/demos/render/lv_demo_render.c
)

# The code below locates the git index file for this repository and adds it as a dependency for
# the application VERSION file so that if the repo has a new commit added, even if no files in
# the build have changed, the application version file will be regenerated with the new git commit
find_package(Git QUIET)
if(GIT_FOUND)
  execute_process(
    COMMAND ${GIT_EXECUTABLE} rev-parse --absolute-git-dir
    WORKING_DIRECTORY .
    OUTPUT_VARIABLE application_git_dir
    OUTPUT_STRIP_TRAILING_WHITESPACE
    ERROR_STRIP_TRAILING_WHITESPACE
    ERROR_VARIABLE stderr
    RESULT_VARIABLE return_code
  )
  # If there is an error e.g. it is not a git repo, we just silently ignore it and continue
  # without a dependency, this will be the case with freestanding applications.
  if(NOT return_code)
    if(NOT "${stderr}" STREQUAL "")
      message(WARNING "Application build version git rev-parse warned: ${stderr}")
    endif()

    set_property(TARGET app_version_h PROPERTY APP_VERSION_DEPENDS ${application_git_dir}/index)
  endif()
endif()
```

## Kconfig
```
# Copyright (c) 2021 Nordic Semiconductor ASA
# SPDX-License-Identifier: Apache-2.0
#
# This file is the application Kconfig entry point. All application Kconfig
# options can be defined here or included via other application Kconfig files.
# You can browse these options using the west targets menuconfig (terminal) or
# guiconfig (GUI).

menu "Zephyr"
source "Kconfig.zephyr"
endmenu

module = APP
module-str = APP
source "subsys/logging/Kconfig.template.log_config"
 
# Include LVGL demo choices (local copy to avoid recursive Kconfig includes)
rsource "Kconfig.lvgl"
```

## Kconfig.lvgl
```
# LVGL demos Kconfig (local copy of zephyr/samples/modules/lvgl/demos/Kconfig)
# Trimmed to avoid recursive inclusion of Kconfig.zephyr
# SPDX-License-Identifier: Apache-2.0

if LVGL

choice LV_Z_DEMO
	prompt "LVGL demo to build"
	# default LV_Z_DEMO_WIDGETS
	default LV_Z_DEMO_RENDER
	help
	  Demo application to build.

config LV_Z_DEMO_MUSIC
	bool "LVGL music demo"
	select LV_USE_DEMO_MUSIC
	help
	  Build music player demo application.

config LV_Z_DEMO_BENCHMARK
	bool "LVGL benchmark demo"
	select LV_USE_DEMO_BENCHMARK
	select LV_USE_DEMO_WIDGETS
	imply LV_USE_PERF_MONITOR
	imply LV_USE_SYSMON
	help
	  Build benchmarking demo application.

config LV_Z_DEMO_STRESS
	bool "LVGL stress demo"
	select LV_USE_DEMO_STRESS
	help
	  Build stress testing demo application.

config LV_Z_DEMO_WIDGETS
	bool "LVGL widgets demo"
	select LV_USE_DEMO_WIDGETS
	help
	  Build widgets demo application.

config LV_Z_DEMO_KEYPAD_AND_ENCODER
	bool "LVGL keypad and encoder demo"
	select LV_USE_DEMO_KEYPAD_AND_ENCODER
	help
	  Build keypad and encoder demo application.

config LV_Z_DEMO_RENDER
	bool "LVGL render demo"
	select LV_USE_DEMO_RENDER
	help
	  Build render demo application.

endchoice

if LV_Z_DEMO_RENDER

config LV_Z_DEMO_RENDER_SCENE_DYNAMIC
	bool "Switch scenes dynamically"
	default y
	help
	  Switch between scenes to render dynamically.

config LV_Z_DEMO_RENDER_SCENE_INDEX
	int "Index of the rendered scene"
	depends on !LV_Z_DEMO_RENDER_SCENE_DYNAMIC
	default 0
	range 0 11
	help
	  Render scene by its index (refer to lv_demo_render.h)

config LV_Z_DEMO_RENDER_DYNAMIC_SCENE_TIMEOUT
	int "Seconds each rendered scene is shown"
	depends on LV_Z_DEMO_RENDER_SCENE_DYNAMIC
	default 3
	help
	  Seconds each rendered scenar is shown

endif # LV_Z_DEMO_RENDER

endif # LVGL
```

## sample.yaml
```
# This file provides example sample configurations for building the application.
# Multiple combinations can be specified so you can build different variants
# locally or in CI.
sample:
  description: Example application
  name: example-application 
common:
  build_only: true
  integration_platforms:
    - apollo510_mini
tests:
  app.default: {}
  app.debug:
    extra_overlay_confs:
      - debug.conf
  app.mcuboot:
    sysbuild: true
    tags: mcuboot
```

## sysbuild.conf
```
# Copyright (c) 2026 Ambiq
# SPDX-License-Identifier: Apache-2.0

# Enable MCUboot as the bootloader via sysbuild
SB_CONFIG_BOOTLOADER_MCUBOOT=y
```

## prj.conf
```kconfig
# Copyright (c) 2026 Ambiq
# SPDX-License-Identifier: Apache-2.0
#
# This file contains selected Kconfig options for the application.

CONFIG_PRINTK=y

# Keep UART output single-source through printk queue thread
CONFIG_LOG=y
CONFIG_TRACING=n

CONFIG_LV_USE_DRAW_AMBIQ=y
CONFIG_LV_USE_AMBIQ_VG=y
CONFIG_LV_DRAW_BUF_ALIGN=8
CONFIG_LV_ATTRIBUTE_MEM_ALIGN_SIZE=8
CONFIG_LV_DRAW_LAYER_SIMPLE_BUF_SIZE=262144
CONFIG_LV_BIN_DECODER_RAM_LOAD=y
CONFIG_LV_USE_SYSMON=y
CONFIG_LV_USE_PERF_MONITOR=y
CONFIG_LV_USE_MEM_MONITOR=y
CONFIG_LV_PERF_MONITOR_ALIGN_BOTTOM_MID=y
CONFIG_LV_MEM_MONITOR_ALIGN_TOP_MID=y
CONFIG_LV_COLOR_DEPTH_16=y
CONFIG_LV_DEF_REFR_PERIOD=16

CONFIG_LV_Z_LARGE_CONST_SECTION=".gfx.assets"
CONFIG_LV_Z_COLOR_24_BGR_TO_RGB=n
CONFIG_LV_Z_FLUSH_THREAD=y
CONFIG_LV_Z_AUTO_INIT=y
CONFIG_LV_Z_RUN_LVGL_ON_WORKQUEUE=n
CONFIG_LV_Z_USE_OSAL=y
CONFIG_LV_Z_MEM_POOL_SYS_HEAP=y
CONFIG_LV_Z_MEM_POOL_SIZE=262144
CONFIG_LV_Z_MEMORY_POOL_CUSTOM_SECTION=y
CONFIG_LV_Z_VDB_SIZE=100
CONFIG_LV_Z_MONOCHROME_CONVERSION_BUFFER=n
CONFIG_LV_Z_BUFFER_ALLOC_DYNAMIC=y
CONFIG_LV_Z_REFRESH_AREA_WIDTH=392
CONFIG_LV_Z_REFRESH_AREA_HEIGHT=392
CONFIG_LV_Z_POINTER_INPUT=y

CONFIG_MAIN_STACK_SIZE=8192
CONFIG_SYSTEM_WORKQUEUE_STACK_SIZE=2048
CONFIG_CPU_LOAD=y
CONFIG_SYS_HEAP_RUNTIME_STATS=y

# Dynamic thread support
CONFIG_DYNAMIC_THREAD=y
CONFIG_DYNAMIC_THREAD_ALLOC=y
CONFIG_DYNAMIC_THREAD_PREFER_ALLOC=y

CONFIG_HEAP_MEM_POOL_SIZE=20480
CONFIG_LV_Z_FLUSH_THREAD_STACK_SIZE=4096

# Runtime stack diagnostics
CONFIG_THREAD_STACK_INFO=y

CONFIG_INPUT_MODE_SYNCHRONOUS=y
CONFIG_INPUT_CHSC5X=y

# PSRAM
CONFIG_MEMC=y
CONFIG_MEMC_MSPI_APS_Z8=y
CONFIG_MEMC_MSPI_APS51216BA=y
CONFIG_WATCHDOG=y
CONFIG_SHELL=n

CONFIG_LVGL=y
CONFIG_LV_Z_SHELL=n
CONFIG_LV_USE_MONKEY=y

# Reset/fatal diagnostics during freeze investigation
CONFIG_HWINFO=y

CONFIG_DISPLAY=y

# Audio DMIC (PDM)
CONFIG_AUDIO=y
CONFIG_AUDIO_DMIC=y

# RTC with alarm support
CONFIG_RTC=y
CONFIG_RTC_ALARM=y

CONFIG_LV_FONT_MONTSERRAT_12=y
CONFIG_LV_FONT_MONTSERRAT_14=y
CONFIG_LV_FONT_MONTSERRAT_16=y
CONFIG_LV_FONT_MONTSERRAT_18=y
CONFIG_LV_FONT_MONTSERRAT_24=y

# Benchmark Demo
CONFIG_LV_USE_FONT_COMPRESSED=y

# MCUboot support
CONFIG_FLASH=y
CONFIG_FLASH_MAP=y
CONFIG_STREAM_FLASH=y
CONFIG_IMG_MANAGER=y
CONFIG_REBOOT=y
```

## boards/apollo510b_mini.conf
```kconfig
# SPDX-License-Identifier: Apache-2.0
# apollo510b_mini: no display/touch; match EVB-class bring-up.

CONFIG_DISPLAY=n
CONFIG_MIPI_DSI=n
CONFIG_LVGL=n
CONFIG_INPUT_CHSC5X=n
CONFIG_LV_Z_POINTER_INPUT=n

CONFIG_AUDIO=n
CONFIG_AUDIO_DMIC=n

# Silence unused LVGL options from prj.conf when LVGL is off.
CONFIG_WARN_EXPERIMENTAL=n

# BLE HR peripheral thread (from samples/bluetooth/peripheral_hr)
CONFIG_BT=y
CONFIG_BT_SMP=y
CONFIG_BT_PERIPHERAL=y
CONFIG_BT_DIS=y
CONFIG_BT_DIS_PNP=n
CONFIG_BT_BAS=y
CONFIG_BT_HRS=y
CONFIG_BT_DEVICE_NAME="Zephyr Heartrate Sensor"
CONFIG_BT_DEVICE_APPEARANCE=833

# MSPI Whoop-style stress thread (aps51216ba on mspi0)
CONFIG_MSPI=y
CONFIG_MSPI_DMA=y
CONFIG_MSPI_TIMING=y
CONFIG_MSPI_AMBIQ_TIMING_SCAN=y
CONFIG_MSPI_COMPLETION_TIMEOUT_TOLERANCE=100
```

## src/main.c
```c
#include <zephyr/kernel.h>
#include <zephyr/drivers/hwinfo.h>
#include <zephyr/drivers/watchdog.h>
#include "shared/shared.h"
#include "threads/blink_threads.h"
#include "threads/gpio_thread.h"
#include "threads/rtc_thread.h"
#include <zephyr/logging/log.h>

#if defined(CONFIG_BT)
#include "threads/ble_hr_thread.h"
#endif

#if defined(CONFIG_MSPI)
#include "threads/mspi_stress_thread.h"
#endif

#if defined(CONFIG_LVGL)
#include "threads/lvgl_demo.h"
#endif

#if defined(CONFIG_AUDIO_DMIC)
#include "threads/audio_thread.h"
#endif

LOG_MODULE_REGISTER(app, LOG_LEVEL_INF);

#define STACKSIZE 1024
#define BLE_STACKSIZE 2048
#define MSPI_STACKSIZE 8192
#define AUDIO_STACKSIZE 4096
#define LVGL_STACKSIZE 8192

#define PRIORITY 7
#define BLE_PRIORITY 7
#define MSPI_PRIORITY 7
#define AUDIO_PRIORITY 8
#define LVGL_PRIORITY 9

/* Must match GRAPHICS_RELEASED_THREADS in lvgl_demo.c */
#define GRAPHICS_RELEASED_THREADS 6U

K_THREAD_DEFINE(blink0_id, STACKSIZE, blink0_thread, NULL, NULL, NULL,
		PRIORITY, 0, 0);
K_THREAD_DEFINE(blink1_id, STACKSIZE, blink1_thread, NULL, NULL, NULL,
		PRIORITY, 0, 0);
K_THREAD_DEFINE(gpio_id, STACKSIZE, gpio_thread, NULL, NULL, NULL,
		PRIORITY, 0, 0);
K_THREAD_DEFINE(rtc_id, STACKSIZE, rtc_thread, NULL, NULL, NULL,
		PRIORITY, 0, 0);

#if defined(CONFIG_BT)
K_THREAD_DEFINE(ble_hr_id, BLE_STACKSIZE, ble_hr_thread, NULL, NULL, NULL,
		BLE_PRIORITY, 0, 0);
#endif

#if defined(CONFIG_MSPI)
K_THREAD_DEFINE(mspi_stress_id, MSPI_STACKSIZE, mspi_stress_thread, NULL, NULL,
		NULL, MSPI_PRIORITY, 0, 0);
#endif

#if defined(CONFIG_AUDIO_DMIC)
K_THREAD_DEFINE(audio_id, AUDIO_STACKSIZE, audio_thread, NULL, NULL, NULL,
		AUDIO_PRIORITY, 0, 0);
#endif

#if defined(CONFIG_LVGL)
K_THREAD_DEFINE(lvgl_demo_id, LVGL_STACKSIZE, lvgl_demo_thread, NULL, NULL, NULL,
		LVGL_PRIORITY, 0, 0);
#endif

int main(void)
{
	const struct device *wdt = DEVICE_DT_GET(DT_ALIAS(watchdog0));
	int wdt_channel_id = -1;
	uint32_t cause = 0U;
	int rc = hwinfo_get_reset_cause(&cause);

	if (rc == 0) {
		LOG_INF("[boot] reset cause: 0x%08x", (unsigned int)cause);
	} else {
		LOG_ERR("[boot] reset cause unavailable (err %d)", rc);
	}

	if (device_is_ready(wdt)) {
		struct wdt_timeout_cfg wdt_config = {
			.window = {
				.min = 0U,
				.max = 10000U,
			},
			.callback = NULL,
			.flags = WDT_FLAG_RESET_SOC,
		};

		wdt_channel_id = wdt_install_timeout(wdt, &wdt_config);
		if (wdt_channel_id >= 0) {
			rc = wdt_setup(wdt, 0U);
			if (rc == 0) {
				LOG_INF("[boot] watchdog enabled: timeout=10000ms, feed=5000ms");
			} else {
				LOG_ERR("[boot] watchdog setup failed (err %d)", rc);
				wdt_channel_id = -1;
			}
		} else {
			LOG_ERR("[boot] watchdog install failed (err %d)", wdt_channel_id);
		}
	} else {
		LOG_ERR("[boot] watchdog device not ready");
	}

#if !defined(CONFIG_LVGL)
	/*
	 * Worker threads wait on graphics_ready_sem. With no LVGL/display,
	 * release them here so blink/gpio/rtc can run.
	 */
	for (uint32_t i = 0; i < GRAPHICS_RELEASED_THREADS; i++) {
		k_sem_give(&graphics_ready_sem);
	}
	LOG_INF("[boot] no display/LVGL; released worker threads");
#endif

	while (1) {
		k_sleep(K_MSEC(5000));
		if (wdt_channel_id >= 0) {
			rc = wdt_feed(wdt, wdt_channel_id);
			if (rc != 0) {
				LOG_ERR("[boot] watchdog feed failed (err %d)", rc);
			}
		}
		LOG_DBG("Main thread loop");
	}

	return 0;
}
```
