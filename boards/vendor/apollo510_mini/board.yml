## boards/vendor/apollo510_mini/board.yml
```yaml
board:
  name: apollo510_mini
  full_name: Apollo 510 Mini Board
  vendor: vendor
  socs:
  - name: apollo510
```

## boards/vendor/apollo510b_mini/Kconfig.apollo510b_mini
```kconfig
# SPDX-License-Identifier: Apache-2.0
# Copyright (c) 2026 Ambiq Micro Inc. <www.ambiq.com>

config BOARD_APOLLO510B_MINI
	select SOC_APOLLO510B
```

## boards/vendor/apollo510b_mini/board.yml
```yaml
board:
  name: apollo510b_mini
  full_name: Apollo 510 Blue Mini Board
  vendor: vendor
  socs:
  - name: apollo510b
```

## drivers/Kconfig
```kconfig
# Copyright (c) 2021 Nordic Semiconductor ASA
# SPDX-License-Identifier: Apache-2.0

menu "Drivers"
rsource "audio_processor/Kconfig"
endmenu
```

## drivers/audio_processor/Kconfig
```kconfig
# SPDX-License-Identifier: Apache-2.0

config AUDIO_PROCESSOR
    bool "Enable Audio Processor driver"
    default n
    select AUDIO_UTILS
    help
      Enable the audio_processor virtual driver which provides capture
      metrics (peak/rms/vad) to the application. This is a simple
      reference driver intended for examples and unit tests.
```

## drivers/mspi/Kconfig
```kconfig
# Copyright (c) 2026 Ambiq Micro Inc.
# SPDX-License-Identifier: Apache-2.0

menuconfig MSPI_FREERTOS
	bool "FreeRTOS-style MSPI drivers"
	help
	  This option enables the out-of-tree mspi_freertos driver class.
	  Drivers in this class expose a thread-safe, interrupt-driven MSPI
	  API whose locking and completion pattern matches the one used by
	  native FreeRTOS MSPI drivers (recursive mutex for bus ownership,
	  binary semaphore released from ISR for completion).

if MSPI_FREERTOS

config MSPI_FREERTOS_INIT_PRIORITY
	int "FreeRTOS MSPI driver init priority"
	default KERNEL_INIT_PRIORITY_DEVICE
	help
	  Device driver init priority for the mspi_freertos class.

module = MSPI_FREERTOS
module-str = mspi_freertos
source "subsys/logging/Kconfig.template.log_config"

config MSPI_FREERTOS_APOLLO510
	bool "Ambiq Apollo510 FreeRTOS MSPI driver"
	default y
	depends on DT_HAS_AMBIQ_APOLLO510_MSPI_FREERTOS_ENABLED
	select PINCTRL
	help
	  Enable the FreeRTOS-style MSPI driver for the Ambiq Apollo510
	  family. The driver serializes all transfers with a mutex and waits
	  on a binary semaphore that is released from the MSPI IRQ handler,
	  mirroring the synchronization pattern used by native FreeRTOS MSPI
	  drivers.

endif # MSPI_FREERTOS
```

## dts/bindings/mspi/ambiq,apollo510-mspi-freertos.yaml
```yaml
# Copyright (c) 2026 Ambiq Micro Inc.
# SPDX-License-Identifier: Apache-2.0

description: |
  Ambiq Apollo510 FreeRTOS-style MSPI controller.

  This node instantiates the out-of-tree `mspi_freertos` driver class for the
  Ambiq Apollo510 family. The driver serializes every transfer with a mutex
  and waits on a binary semaphore released from the controller's IRQ handler,
  mirroring the synchronization pattern used by native FreeRTOS MSPI drivers.

  Example:

    mspi_freertos0: mspi-freertos@40014000 {
        compatible = "ambiq,apollo510-mspi-freertos";
        reg = <0x40014000 0x400>;
        interrupts = <20 0>;
        clock-frequency = <48000000>;
        ambiq,channel = <0>;
        ambiq,io-mode = <0>;
        pinctrl-0 = <&mspi0_default>;
        pinctrl-names = "default";
        status = "okay";
    };

compatible: "ambiq,apollo510-mspi-freertos"

include: [base.yaml, pinctrl-device.yaml]

properties:
  reg:
    required: true

  interrupts:
    required: true

  clock-frequency:
    type: int
    required: true
    description: Default MSPI SCLK frequency in Hz.

  ambiq,channel:
    type: int
    default: 0
    description: |
      Apollo510 MSPI hardware channel index (0..3). Selects which physical
      MSPI controller this node binds to.

  ambiq,io-mode:
    type: int
    default: 0
    description: |
      MSPI line-width selector used by the low-level HAL shim. The value is
      passed through to the vendor HAL and is not interpreted by the driver
      itself; 0 selects the HAL default (single line / legacy SPI).

  pinctrl-0:
    required: true

  pinctrl-names:
    required: true
```

## lib/Kconfig
```kconfig
# Copyright (c) 2021 Legrand North America, LLC.
# SPDX-License-Identifier: Apache-2.0

menu "Custom libraries"

rsource "audio_utils/Kconfig"
rsource "diag/Kconfig"

endmenu
```

## lib/audio_utils/Kconfig
```kconfig
# SPDX-License-Identifier: Apache-2.0

config AUDIO_UTILS
    bool "Support for audio utilities library"
    help
      This option enables the small audio utilities library used by the
      example application (peak, RMS and simple VAD helpers).
```

## lib/diag/Kconfig
```kconfig
# SPDX-License-Identifier: Apache-2.0

config DIAG
    bool "Support for diag utilities library"
    help
      Enables the small diagnostics helper library used by the example
      application (reset cause formatting and helpers).
```

## west.yml
```yaml
# Copyright (c) 2021 Nordic Semiconductor ASA
# SPDX-License-Identifier: Apache-2.0

manifest:
  remotes:
    - name: ambiq
      url-base: https://github.com/AmbiqMicro

  projects:
    - name: zephyr
      remote: ambiq
      repo-path: zephyr-ambiq-internal
      # origin/ambiq-stable
      revision: 4cbbf5b4054020788629f05df0d9962ef35b93e9
      import:
        # By using name-allowlist we can clone only the modules that are
        # strictly needed by the application.
        name-allowlist:
          - cmsis_6    # required by the ARM port for Cortex-M
          - hal_ambiq_internal

    # Pin matches zephyr/west.yml @ 4cbbf5b40540 (ambiq-stable).
    - name: hal_ambiq_internal
      remote: ambiq
      repo-path: hal_ambiq_internal
      revision: 1577f6e52eebdf5a3a2e2082d5161c1c81858948
      path: modules/hal/ambiq
```
