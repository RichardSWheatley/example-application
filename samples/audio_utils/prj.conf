## CMakeLists.txt
```
# SPDX-License-Identifier: Apache-2.0

cmake_minimum_required(VERSION 3.20.0)
find_package(Zephyr REQUIRED HINTS $ENV{ZEPHYR_BASE})
project(audio_utils_sample)

target_sources(app PRIVATE src/main.c)
```

## sample.yaml
```
common:
  tags: audio
tests:
  lib.audio_utils: {}
```

## prj.conf
```kconfig
# Sample build configuration
CONFIG_AUDIO_UTILS=y
```

## src/main.c
```c
/* SPDX-License-Identifier: Apache-2.0 */

#include <zephyr/kernel.h>
#include <zephyr/sys/printk.h>
#include <app/lib/audio.h>
#include <stdint.h>
#include <math.h>
#include <stdbool.h>

int main(void)
{
    int32_t samples[] = {0, -100, 456, -1000};
    int peak = audio_peak(samples, sizeof(samples), 4);
    double r = audio_rms(samples, sizeof(samples), 4);
    bool vad1 = audio_vad(samples, sizeof(samples), 4, 500);
    bool vad2 = audio_vad(samples, sizeof(samples), 4, 1500);

    printk("Audio utils: peak=%d, rms=%f, vad(500)=%d, vad(1500)=%d\n",
           peak, r, vad1 ? 1 : 0, vad2 ? 1 : 0);
    
    return 0;
}
```
